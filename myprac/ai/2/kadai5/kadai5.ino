#define USE_TIMER3_ISR
#include "mono_con.h"

int x, y;
int tsw, sw, ph;


word in;

int getidx(int x, int y) {
	int dx = x - 512;
	int dy = y - 512;

	if (abs(dx) < 250 && abs(dy) < 250) return 4;

	if (abs(dy) >= abs(dx)) {
		return (dy < 0) ? 0 : 1;
	} else {
		return (dx < 0) ? 3 : 2;
	}
}

ISR(TIMER3_COMPA_vect) {
	if (in++ > 5) {
		in = 0;

		x = analogRead(A1);
		y = analogRead(A2);
		tsw = digitalRead(_USER_CON_5PIN);
		sw = digitalRead(_USER_CON_4PIN);
		ph = digitalRead(_USER_CON_3PIN);
	}
}

void setup() {
	config_init();
	serial_init();

	x = analogRead(A1);
	y = analogRead(A2);
	tsw = digitalRead(_USER_CON_5PIN);
	sw = digitalRead(_USER_CON_4PIN);
	ph = digitalRead(_USER_CON_3PIN);
}

void loop() {
	if (tsw == HIGH) {
		lm.color.GBR = B100;
		
	} else {
		lm.color.GBR = B000;

	}

	led_stepmotor(lm.b8);
}

/*
問題5　数当てゲーム（ナンバーガッシング）　　　　配点40点
数当てゲームとは、コンピュータが0〜99の中からランダムに選んだ2桁の数字を、人間が予想して当てるゲームである。人間の予想に対して「もっと大きい（HIGH）」「もっと小さい（LOW）」のヒントが表示される。
■ 概要
数当てゲームで、人間とコンピュータが対戦できるようにする。
■ システム構成図
[入力回路]                        [出力回路]
 トグルSW  ─┐                  ┌─ 7セグメントLED
 タクトSW  ─┤                  ├─ 圧電スピーカ
 ジョイスティック ─┼─→ マイコン ─┼─ フルカラーLED
 フォトインタラプタ─┘                  └─ ステッピングモータ
■ 初期状態
＜注意事項＞(8)に記載の通り。ただし、7セグメントLEDは全消灯とする。
■ 動作内容
(1) ゲーム状態の管理（配点10点）
トグルSWでゲームの状態（表5-1）を管理する。
表5-1.　ゲーム状態
トグルSWゲームの状態フルカラーLEDONゲーム中状態緑点灯OFFゲーム初期状態消灯
ゲーム中状態でタクトSWを押下するとゲームが始まる。

ゲーム開始時、コンピュータは0〜99の乱数を1つ生成し記憶する。
7セグメントLEDの両桁に「--」相当の表示（中央セグメントのみ点灯）でゲーム開始を示す。
開始間隔のカウントダウン（3 → 2 → 1 → 0）を1秒ごとに7セグメントLEDの1桁目に表示する。

(2) 数値入力（配点10点）
ジョイスティックを用いて、人間が予想する2桁の数値を入力する。
表5-2.　数値入力方法
ジョイスティック動作上1桁目（または選択中の桁）の数字を+1下1桁目（または選択中の桁）の数字を-1左2桁目（十の位）を選択右1桁目（一の位）を選択中心何もしない

ジョイスティックの入力を受け付ける間隔は400msec以上空けること（チャタリング防止）。
数字は0〜9でループする（9の次は0、0の前は9）。
選択中の桁は、対応する桁の小数点（ドット）を点灯させて示す。
タクトSWを押下すると、入力を確定する。

(3) 判定とヒント表示（配点10点）
入力された数値とコンピュータの数値を比較し、結果を表示する。
表5-3.　判定とヒント
判定7セグメントLEDフルカラーLEDブザー入力 < 答え「H」を1桁目に表示赤点灯（500msec）C4を200msec入力 > 答え「L」を1桁目に表示青点灯（500msec）B3を200msec入力 = 答え入力値を表示し、両方のドット点灯緑点滅（3回）正解音演奏
正解音は以下のメロディとする（表5-4参照）。
表5-4.　正解時のファンファーレ
12345音階C4E4G4C5C5長さ200ms200ms200ms400ms400ms
(4) 残り回数とステッピングモータ表現（配点5点）

1ゲームあたりの予想回数は10回までとする。
ステッピングモータでメモリを表現し、初期位置を「10回残り」とする。
1回予想するごとに、ステッピングモータがCW方向に36°回転する（10回で1回転、360°）。
残り回数が0になっても正解できなかった場合、ゲームオーバーとし、ブザーで「ファ→ミ→レ→ド（F4 → E4 → D4 → C4）」のメロディを各400msecで演奏する。
ゲームオーバー時はフルカラーLEDを赤点滅させ、7セグメントLEDに正解の数字を表示する。

(5) ゲームのリセットと演出（配点5点）

正解またはゲームオーバー後、トグルSWをOFFにすると初期状態に戻り、ステッピングモータは元の位置（0°）に戻る。
再度トグルSWをONにすると、新しいゲームが開始可能になる。
ゲーム中、フォトインタラプタを遮断するとヒント機能を強化する「ヒントモード」となる。

ヒントモード中は、入力値と答えの差が10未満の場合、ブザーが「ピピッ」と短い音（C5を50msec、2回）を鳴らす。
ヒントモード中はフルカラーLEDが緑→青→緑→青と500msec間隔で点滅する。



以上
*/